## designs/cameras/ov9281/variants/slim-flex/checkpoints/2026-10-29-r11-slimflex/files/designs/eye-camera-ov9281/firmware/sdkconfig.defaults
```kconfig
CONFIG_IDF_TARGET="esp32p4"
CONFIG_ESP32P4_SELECTS_REV_LESS_V3=n
CONFIG_ESP32P4_REV_MIN_300=y
CONFIG_SPIRAM=y
CONFIG_SPIRAM_SPEED_80M=y
CONFIG_ESPTOOLPY_FLASHSIZE_4MB=y
CONFIG_ESPTOOLPY_FLASHMODE_DIO=y
CONFIG_ESPTOOLPY_FLASHFREQ_40M=y
CONFIG_FREERTOS_HZ=1000
CONFIG_CAMERA_OV9281=y
CONFIG_CAMERA_OV9281_AUTO_DETECT_MIPI_INTERFACE_SENSOR=n
CONFIG_CAMERA_OV9281_MIPI_RAW8_640X400_100FPS=y
CONFIG_CAMERA_OV9281_MIPI_DEFAULT_FMT_RAW8_640X400_100FPS=y
CONFIG_CAMERA_OV9281_SID_LOW=y
CONFIG_TINYUSB_CDC_ENABLED=y
CONFIG_TINYUSB_CDC_COUNT=1
CONFIG_TINYUSB_CDC_RX_BUFSIZE=64
CONFIG_TINYUSB_CDC_TX_BUFSIZE=8192
CONFIG_TINYUSB_DESC_USE_ESPRESSIF_VID=n
CONFIG_TINYUSB_DESC_CUSTOM_VID=0xCAFE
CONFIG_TINYUSB_DESC_USE_DEFAULT_PID=n
CONFIG_TINYUSB_DESC_CUSTOM_PID=0x4011
CONFIG_TINYUSB_DESC_MANUFACTURER_STRING="SkellyCAD development"
CONFIG_TINYUSB_DESC_PRODUCT_STRING="R11 OV9281 RAW8 bench prototype"
CONFIG_TINYUSB_DESC_SERIAL_STRING="SKELLY-BENCH-001"
CONFIG_SKELLY_SYNTHETIC=n
```

## designs/cameras/ov9281/variants/slim-flex/src/firmware/main/Kconfig.projbuild
```kconfig
menu "Skelly eye camera"
config SKELLY_SYNTHETIC
    bool "Use synthetic pixels instead of the physical sensor"
    default n
    help
        USB bring-up only. Every returned frame has its synthetic flag set.
        Does not initialize the sensor or prove camera capture.
endmenu

config SKELLY_CSI_LANE_MBPS
    int "CSI receiver lane bit rate (requires bench verification)"
    range 400 800
    default 800
    help
        Register-table header says 800 Mbps; driver metadata says 400 MHz.
        Default follows the explicit bit-rate header. Change for measured
        bring-up only; compilation cannot resolve this upstream discrepancy.
```
